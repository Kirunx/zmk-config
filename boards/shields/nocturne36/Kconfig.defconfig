## boards/shields/nocturne36/Kconfig.defconfig
```kconfig
config ZMK_KEYBOARD_NAME
    default "Nocturne36"


if SHIELD_NOCTURNE36_LEFT

config ZMK_SPLIT_ROLE_CENTRAL
    default y
endif

if SHIELD_NOCTURNE36_RIGHT

config ZMK_SPLIT
    default y

endif

#if ZMK_DISPLAY

#config I2C
#	default y

#config SSD1306
#	default y

#endif # ZMK_DISPLAY


config ZMK_DISPLAY
    default y
    select LV_USE_CONT
    select LV_FONT_MONTSERRAT_26
    select LV_FONT_MONTSERRAT_16
    select LV_USE_LABEL
    select LV_USE_IMG

config I2C
    default y

config SSD1306
    default y

# if LVGL
config LVGL
    default y
config LV_Z_VDB_SIZE
    default 64

config LV_DPI_DEF
    int
    default 148

config LV_Z_BITS_PER_PIXEL
    default 1

choice LV_COLOR_DEPTH
    default LV_COLOR_DEPTH_1
endchoice

# endif # LVGL
```

## boards/shields/nocturne36/Kconfig.shield
```kconfig
config SHIELD_NOCTURNE36_LEFT
    def_bool $(shields_list_contains,nocturne36_left)
config SHIELD_NOCTURNE36_RIGHT
    def_bool $(shields_list_contains,nocturne36_right)
```
