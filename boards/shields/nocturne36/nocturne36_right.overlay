#include "nocturne36.dtsi"
&default_transform{
    col-offset = <5>;
}
&kscan0 {
    col-gpios = 
            <&pro_micro 10 GPIO_ACTIVE_HIGH>,  /* col0 → D10 → P0.09 */
            <&pro_micro 9  GPIO_ACTIVE_HIGH>,  /* col1 → D9  → P1.06 */
            <&pro_micro 8  GPIO_ACTIVE_HIGH>,  /* col2 → D8  → P1.04 */
            <&pro_micro 7  GPIO_ACTIVE_HIGH>,  /* col3 → D7  → P0.11 */
            <&pro_micro 6  GPIO_ACTIVE_HIGH>;  /* col4 → D6  → P1.00 */

}